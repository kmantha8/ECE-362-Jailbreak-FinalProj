#include <stdio.h>
#include "pico/stdlib.h"
#include "hardware/pio.h"
#include "hardware/dma.h"
#include "hub75.pio.h" // Generated by the SDK from your .pio file

#define WIDTH 64
#define HEIGHT 32

// Update these to match your wiring
#define DATA_BASE_PIN 0  // R1, G1, B1, R2, G2, B2 pins starting here
#define CLK_PIN 6
#define LAT_PIN 7
#define OE_PIN 8
#define ADDR_BASE_PIN 9 // A, B, C, D address pins

// Framebuffer: 32 rows, each row has 64 pixels. 
// Standard HUB75 drives two halves (0-15 and 16-31) simultaneously.
uint32_t framebuffer[WIDTH * (HEIGHT / 2)];

void setup_matrix() {
    PIO pio = pio0;
    uint sm = 0;
    uint offset = pio_add_program(pio, &hub75_program);
    
    // Configure PIO pins
    hub75_program_init(pio, sm, offset, DATA_BASE_PIN, CLK_PIN);
    
    // Setup Address and Control pins
    for(int i=0; i<4; i++) gpio_init(ADDR_BASE_PIN + i), gpio_set_dir(ADDR_BASE_PIN + i, GPIO_OUT);
    gpio_init(LAT_PIN); gpio_set_dir(LAT_PIN, GPIO_OUT);
    gpio_init(OE_PIN);  gpio_set_dir(OE_PIN, GPIO_OUT);
}

int main() {
    stdio_init_all();
    setup_matrix();

    // SIMPLE TEST PATTERN: Red Border
    for (int y = 0; y < HEIGHT; y++) {
        for (int x = 0; x < WIDTH; x++) {
            if (x == 0 || x == 63 || y == 0 || y == 31) {
                // Set pixel to Red (Binary: R1G1B1 R2G2B2)
                // This logic depends on which row half you are in
            }
        }
    }

    while (true) {
        for (int row = 0; row < 16; row++) {
            // 1. Set Address Pins (A, B, C, D)
            gpio_put_masked(0xF << ADDR_BASE_PIN, row << ADDR_BASE_PIN);
            
            // 2. Shift data via PIO (Simplified for test)
            for (int x = 0; x < WIDTH; x++) {
                pio_sm_put_blocking(pio0, 0, 0b100100); // Example: R1 and R2 High
            }

            // 3. Latch and Display
            gpio_put(OE_PIN, 1);  // Disable display
            gpio_put(LAT_PIN, 1); // Latch data
            sleep_us(1);
            gpio_put(LAT_PIN, 0);
            gpio_put(OE_PIN, 0);  // Enable display
            sleep_us(100);        // Display time
        }
    }
}
